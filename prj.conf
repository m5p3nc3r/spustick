## prj.conf
```kconfig
# This file expresses generic requirements ONLY; see README.rst.

CONFIG_LOG=y

CONFIG_GPIO=y

CONFIG_USB=y
CONFIG_USB_DEVICE_STACK=y
CONFIG_USB_DEVICE_HID=y
CONFIG_USB_DEVICE_PRODUCT="Spustick"
CONFIG_USB_DEVICE_MANUFACTURER="Apptabulous"

CONFIG_LED_STRIP=y
CONFIG_WS2812_STRIP=y
```

## boards/96b_carbon.conf
```kconfig
#CONFIG_POLL=y

# This is needed to support led_strip on 96b_carbon
CONFIG_SPI=y
CONFIG_SPI_STM32=y
CONFIG_SPI_STM32_INTERRUPT=y
CONFIG_SPI_2=y
```

## src/main.c
```c
#include <zephyr.h>

#include "leds.h"

void main(void) {
  leds_init();

  while(true) {
    k_sleep(MSEC_PER_SEC);
  }
}
```

## src/joystick_hid.c
```c
// =============================================================================
// USB HID
// =============================================================================

#include <zephyr.h>
#include <init.h>
#include <usb/usb_device.h>
#include <usb/class/usb_hid.h>

#include "joystick_hid.h"
#include "joystick_input.h"

#include <logging/log.h>
LOG_MODULE_REGISTER(joystick_hid);

#define INPUT_DATA          (0U << 0)
#define INPUT_CONSTANT      (1U << 0)
#define INPUT_ARRAY         (0U << 1)
#define INPUT_VARIABLE      (1U << 1)
#define INPUT_ABSOLUTE      (0U << 2)
#define INPUT_RELATIVE      (1U << 2)

#define JOYSTICK_REPORT(id)                   \
  HID_GI_USAGE_PAGE, USAGE_GEN_DESKTOP,       \
  HID_LI_USAGE, USAGE_GEN_DESKTOP_JOYSTICK,   \
  HID_MI_COLLECTION, COLLECTION_APPLICATION,  \
    HID_MI_COLLECTION, COLLECTION_PHYSICAL,   \
      HID_GI_REPORT_ID, id,                   \
                                              \
      HID_GI_USAGE_PAGE, USAGE_GEN_BUTTON,    \
      HID_LI_USAGE_MIN(1), 0x01,              \
      HID_LI_USAGE_MAX(1), NUM_BUTTONS,              \
      HID_GI_LOGICAL_MIN(1), 0x00,            \
      HID_GI_LOGICAL_MAX(1), 0x01,            \
      HID_GI_REPORT_SIZE, 1,                  \
      HID_GI_REPORT_COUNT, NUM_BUTTONS,                 \
      HID_MI_INPUT, INPUT_DATA | INPUT_VARIABLE | INPUT_ABSOLUTE, \
                                              \
      HID_GI_USAGE_PAGE, USAGE_GEN_DESKTOP,   \
      HID_LI_USAGE, USAGE_GEN_DESKTOP_X,      \
      HID_LI_USAGE, USAGE_GEN_DESKTOP_Y,      \
      HID_GI_LOGICAL_MIN(1), -127,            \
      HID_GI_LOGICAL_MAX(1), 127,             \
      HID_GI_REPORT_SIZE, 8,                  \
      HID_GI_REPORT_COUNT, 2,                 \
      HID_MI_INPUT, INPUT_DATA | INPUT_VARIABLE | INPUT_ABSOLUTE, \
    HID_MI_COLLECTION_END,                    \
  HID_MI_COLLECTION_END

static const u8_t hid_report[] = {
  JOYSTICK_REPORT(1), // Report ID 0 is invalid
#if NUM_JOYSTICKS>1
  JOYSTICK_REPORT(2),
#endif
};



void hid_worker_handler(struct k_work *work);
//void hid_timer_handler(struct k_timer *timer);
K_WORK_DEFINE(hid_worker, hid_worker_handler);
//K_TIMER_DEFINE(hid_timer, hid_timer_handler, NULL);

static bool connected=false;

static void status_cb(enum usb_dc_status_code status, const u8_t *param)
{
  #define NOT_READY(STATE) LOG_INF("Status " #STATE " %d", param ? *param : -1); connected=false;
  #define READY(STATE) LOG_INF("Status " #STATE " %d", param ? *param : -1); connected=true;
	switch (status) {
    case USB_DC_ERROR: NOT_READY(USB_DC_ERROR); break;
    case USB_DC_RESET: NOT_READY(USB_DC_RESET); break;
    case USB_DC_CONNECTED: NOT_READY(USB_DC_CONNECTED); break;
    case USB_DC_CONFIGURED: READY(USB_DC_CONFIGURED); break;
    case USB_DC_DISCONNECTED: NOT_READY(USB_DC_DISCONNECTED); break;
    case USB_DC_SUSPEND: NOT_READY(USB_DC_SUSPEND); break;
    case USB_DC_RESUME: READY(USB_DC_RESUME); break;
    case USB_DC_UNKNOWN:
	  default:
		  LOG_INF("Unknonw status %d", status);
		  break;
	}
}

static const struct hid_ops ops = {
  .status_cb = status_cb,
};

typedef struct {
  u8_t id;
  joystickState state;
} joystickReport;

typedef struct {
  struct k_work work;
  joystickReport report;
} joystickWorker;
static joystickWorker joystickWorkers[NUM_JOYSTICKS];

// Not sure this is the right way to do this, but hacking this in here for now
static struct device *hid_dev;

void hid_worker_handler(struct k_work *work) {
  joystickWorker *worker=CONTAINER_OF(work, joystickWorker, work);

  hid_int_ep_write(hid_dev, (char *)&worker->report, sizeof(joystickReport), NULL);
}

void joystick_post_update(int id, const joystickState *state) {
  if(id<NUM_JOYSTICKS) {
    joystickWorker *worker=&joystickWorkers[id];
    // Copy over the state
    memcpy(&worker->report.state, state, sizeof(joystickState));
    // Post the work
    if(connected) {
      k_work_submit(&worker->work);
    }
  }
}

joystickState *joystick_hid_get_state(int id) {
  joystickState *ret=id<NUM_JOYSTICKS ? &joystickWorkers[id].report.state : NULL;
  return ret;
}

static int joystick_hid_init(struct device *dev)
{
	ARG_UNUSED(dev);

  // Initialise the joystick input interfaces
  joystick_input_init();

	// Initialise the HID output interfaces
	hid_dev = device_get_binding("HID_0");
	if(hid_dev == NULL) {
		LOG_ERR("Cannot get USB HID Device");
		return -ENODEV;
	}

	usb_hid_register_device(hid_dev, hid_report, sizeof(hid_report), &ops);
  // Initialise report ids
  for(int j=0; j<NUM_JOYSTICKS; j++) {
    joystickWorkers[j].report.id = j+1;
    k_work_init(&joystickWorkers[j].work, hid_worker_handler);
  }

	return usb_hid_init(hid_dev);
}

SYS_INIT(joystick_hid_init, APPLICATION, CONFIG_KERNEL_INIT_PRIORITY_DEVICE);
```

## src/joystick_hid.h
```c
#ifndef _joystick_hid_h
#define _joystick_hid_h

#define NUM_JOYSTICKS 2
// Number of buttons per joystick
#define NUM_BUTTONS 4

typedef struct {
  // Keep this the same form as the Descriptor
  union {
    u8_t buttons;
    struct {
      u8_t b1:1;
      u8_t b2:1;
      u8_t b3:1;
      u8_t b4:1;
      u8_t b5:1;
      u8_t b6:1;
      u8_t b7:1;
      u8_t b8:1;
    };
  };
  s8_t x;
  s8_t y;
} joystickState;

void joystick_post_update(int id, const joystickState *state);
joystickState *joystick_hid_get_state(int id);


#endif
```

## src/joystick_input.c
```c
// =============================================================================
// Button input
// =============================================================================
#include <zephyr.h>
#include <device.h>
#include <gpio.h>

#define LOG_LEVEL 4
#include <logging/log.h>
LOG_MODULE_REGISTER(input);

#include "joystick_input.h"
#include "joystick_hid.h"

#define USE_DEBUG_JOYSTICK 0

#define INPUT_JOYSTICK_UP    0
#define INPUT_JOYSTICK_DOWN  1
#define INPUT_JOYSTICK_LEFT  2
#define INPUT_JOYSTICK_RIGHT 3
#define INPUT_JOYSTICK_A     4
#define INPUT_JOYSTICK_B     5
#define INPUT_JOYSTICK_C     6
#define INPUT_JOYSTICK_D     7

typedef struct button {
  u32_t pin;
  u32_t key;
  const char *name;
} button;

#define INPUT_DRV_NAME "GPIOC"

struct button buttons[] = {
  { pin: 4, key: INPUT_JOYSTICK_LEFT,   name: "Left"  },
  { pin: 2, key: INPUT_JOYSTICK_UP,     name: "Up" },
  { pin: 6, key: INPUT_JOYSTICK_DOWN,   name: "Down" },
  { pin: 8, key: INPUT_JOYSTICK_RIGHT,  name: "Right" },
  { pin: 3, key: INPUT_JOYSTICK_A,      name: "A" },
  { pin: 5, key: INPUT_JOYSTICK_B,      name: "B" },
  { pin: 7, key: INPUT_JOYSTICK_C,      name: "C" },
  { pin: 9, key: INPUT_JOYSTICK_D,      name: "D" },
};
static int numButtons = ARRAY_SIZE(buttons);

#if USE_DEBUG_JOYSTICK

static int debugJoystickId=0;
static void joystick_debug_update_state(joystickState *state) {
  static s8_t x=0, y=0;
  static u8_t b=0;

  state->x=x++;
  state->y=y--;
  state->buttons = b++;
}

static void joystick_debug_emit(struct k_timer *timer) {
  ARG_UNUSED(timer);
  joystickState *state=joystick_hid_get_state(debugJoystickId);
  joystick_debug_update_state(state);
  joystick_post_update(debugJoystickId, state);
  debugJoystickId+=1;
  if(debugJoystickId==NUM_JOYSTICKS) debugJoystickId=0;
}

K_TIMER_DEFINE(joystick_debug_timer, joystick_debug_emit, NULL);

void joystick_input_init() {
  k_timer_start(&joystick_debug_timer, K_MSEC(40), K_MSEC(40));
}

#else

static struct gpio_callback gpio_cb;

static void setJoystickState(joystickState *state, int key, int val) {
  switch(key) {
    case INPUT_JOYSTICK_A: state->b1 = val; break;
    case INPUT_JOYSTICK_B: state->b2 = val; break;
    case INPUT_JOYSTICK_C: state->b3 = val; break;
    case INPUT_JOYSTICK_D: state->b4 = val; break;
    case INPUT_JOYSTICK_UP: if(!val) state->y=127; break;
    case INPUT_JOYSTICK_DOWN: if(!val) state->y=-127; break;
    case INPUT_JOYSTICK_LEFT: if(!val) state->x=-127; break;
    case INPUT_JOYSTICK_RIGHT: if(!val) state->x=127; break;
  }
}

void button_pressed(struct device *dev, struct gpio_callback *cb, u32_t pins) {
  u32_t val=0;
  int err, index=0;
  int id=0;

  joystickState *state=joystick_hid_get_state(id);

  // Walk over all the configured inputs to see which one changed
  for(; index<numButtons; index++) {
    struct button *b=&buttons[index];
    if(pins & BIT(b->pin)) {
      err = gpio_pin_read(dev, b->pin, &val);
      if(err!=0) {
        LOG_ERR("Error reading pin");
      }
      printk("Button %s => %d\n", b->name, val);
      setJoystickState(state, b->key, val);
    }
  }
  joystick_post_update(id, state);
}

void joystick_bootstrap_state(struct device *dev, int id) {
  joystickState *state=joystick_hid_get_state(id);
  u32_t val;
  int err, index=0;
  memset(state, 0, sizeof(joystickState));
  state->x=0; state->y=0;
  for(; index<numButtons; index++) {
    struct button *b=&buttons[index];
    err = gpio_pin_read(dev, b->pin, &val);
    setJoystickState(state, b->key, val);
  }
  joystick_post_update(id, state);
}


void joystick_input_init() {
  int ret, index=0;
  u32_t mask = 0;
  static u32_t flags = (GPIO_DIR_IN | GPIO_INT | GPIO_PUD_PULL_DOWN |
    GPIO_INT_EDGE | GPIO_INT_DOUBLE_EDGE | GPIO_INT_DEBOUNCE);

  struct device *inputDev = device_get_binding(INPUT_DRV_NAME);
  if(!inputDev) {
    LOG_ERR("Cannot find input device %s", INPUT_DRV_NAME);
    return;
  }

  for(index=0; index<numButtons; index++) {
    button *b = &buttons[index];
    ret = gpio_pin_configure(inputDev, b->pin, flags);
    if(ret) {
      LOG_ERR("Error configuring %s pin %d", INPUT_DRV_NAME, b->pin);
      return;
    }
    mask |= BIT(b->pin);
    gpio_pin_enable_callback(inputDev, b->pin);
  }

  gpio_init_callback(&gpio_cb, button_pressed, mask);

  gpio_add_callback(inputDev, &gpio_cb);

  joystick_bootstrap_state(inputDev, 0);
}
#endif
```

## src/joystick_input.h
```c
#ifndef __INPUT_H
#define __INPUT_H

#include "joystick_hid.h"

void joystick_input_init();

#endif
```

## src/leds.h
```c
#ifndef __leds_h
#define __leds_h

void leds_init(void);


#endif
```

## src/ws2812_led.c
```c
#include <zephyr.h>
#include <device.h>
#include <led_strip.h>

#include <logging/log.h>
LOG_MODULE_REGISTER(ws2812_led);


/* ========================================
* Colour conversion code
* Code taken from https://stackoverflow.com/questions/1737726/how-to-perform-rgb-yuv-conversion-in-c-c
*/
 #define CLIP(X) ( (X) > 255 ? 255 : (X) < 0 ? 0 : X)

// RGB -> YUV
#define RGB2Y(R, G, B) CLIP(( (  66 * (R) + 129 * (G) +  25 * (B) + 128) >> 8) +  16)
#define RGB2U(R, G, B) CLIP(( ( -38 * (R) -  74 * (G) + 112 * (B) + 128) >> 8) + 128)
#define RGB2V(R, G, B) CLIP(( ( 112 * (R) -  94 * (G) -  18 * (B) + 128) >> 8) + 128)

// YUV -> RGB
#define C(Y) ( (Y) - 16  )
#define D(U) ( (U) - 128 )
#define E(V) ( (V) - 128 )

#define YUV2R(Y, U, V) CLIP(( 298 * C(Y)              + 409 * E(V) + 128) >> 8)
#define YUV2G(Y, U, V) CLIP(( 298 * C(Y) - 100 * D(U) - 208 * E(V) + 128) >> 8)
#define YUV2B(Y, U, V) CLIP(( 298 * C(Y) + 516 * D(U)              + 128) >> 8)

// RGB -> YCbCr
#define CRGB2Y(R, G, B) CLIP((19595 * R + 38470 * G + 7471 * B ) >> 16)
#define CRGB2Cb(R, G, B) CLIP((36962 * (B - CLIP((19595 * R + 38470 * G + 7471 * B ) >> 16) ) >> 16) + 128)
#define CRGB2Cr(R, G, B) CLIP((46727 * (R - CLIP((19595 * R + 38470 * G + 7471 * B ) >> 16) ) >> 16) + 128)

// YCbCr -> RGB
#define CYCbCr2R(Y, Cb, Cr) CLIP( Y + ( 91881 * Cr >> 16 ) - 179 )
#define CYCbCr2G(Y, Cb, Cr) CLIP( Y - (( 22544 * Cb + 46793 * Cr ) >> 16) + 135)
#define CYCbCr2B(Y, Cb, Cr) CLIP( Y + (116129 * Cb >> 16 ) - 226 )



#define STRIP_DEV_NAME DT_INST_0_WORLDSEMI_WS2812_LABEL
#define STRIP_NUM_LEDS 2
#define DELAY_TIME K_MSEC(40)

//30

struct led_rgb strip_colors[STRIP_NUM_LEDS];

typedef struct _phase {
  u8_t val;
  s8_t step;
} phase;

void phase_init(phase *p, u8_t val, u8_t step) {
  p->val=val;
  p->step=step;
}

u8_t phase_step(phase *p) {
  s32_t val = (s32_t)p->val + p->step;
  if(val<0) {
    val = -val;
    p->step = -p->step;
  } else if(val>=255){
    val = 255 - (val - 255);
    p->step = -p->step;
  }
  p->val = (u8_t)val;
  return p->val;
}


static struct device *strip;
static phase red, green, blue;

void led_work_handler(struct k_work *work) {
  int err;
  err=led_strip_update_rgb(strip, &strip_colors[0], STRIP_NUM_LEDS);
  if(err!=0) {
    LOG_ERR("Led update error code %d",err);
  }
}
K_WORK_DEFINE(led_work, led_work_handler);

static void led_emit(struct k_timer *timer) {
  ARG_UNUSED(timer);
  int err;

//  LOG_ERR("LED_EMIT %p", strip);

  for(int i=0; i<STRIP_NUM_LEDS; i++) {
    strip_colors[i].r=phase_step(&red);
    strip_colors[i].g=phase_step(&green);
    strip_colors[i].b=phase_step(&blue);
  }

  k_work_submit(&led_work);
}

K_TIMER_DEFINE(led_timer, led_emit, NULL);

void leds_init(void) {
	LOG_INF("Starting ws2812 code...");
  strip = device_get_binding(STRIP_DEV_NAME);
  if(!strip) {
    LOG_ERR("Unable to open led strip %s", STRIP_DEV_NAME);
    return;
  }
  LOG_ERR("Setup ok");

  phase_init(&red, 0, 1);
  phase_init(&green, 0, 2);
  phase_init(&blue, 0, 3);

  k_timer_start(&led_timer, K_MSEC(40), K_MSEC(40));
}
```
